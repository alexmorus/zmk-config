## boards/shields/rk61_hw/Kconfig.defconfig
```kconfig
if SHIELD_RK61_HW

config ZMK_KEYBOARD_NAME
    default "rk61_hw"
CONFIG_ZMK_STUDIO=y
CONFIG_ZMK_BATTERY_REPORTING=y
CONFIG_ZMK_BATTERY_REPORT_INTERVAL=300
CONFIG_ZMK_USB=y
CONFIG_ZMK_SLEEP=y
CONFIG_ZMK_BLE_EXPERIMENTAL_CONN=y
CONFIG_BT_CTLR_TX_PWR_PLUS_8=y

endif
```

#include <physical_layouts.dtsi>


/ {
    physical_layout0: physical_layout_0 {
        compatible = "zmk,physical-layout";
        display-name = "Default";
        transform = <&default_transform>;
        kscan = <&kscan0>;
        battery = <&vbatt>;
    };
};